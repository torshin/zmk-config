## app/boards/shields/dima3/Kconfig.defconfig
```kconfig
if SHIELD_DIMA3_LEFT

config ZMK_KEYBOARD_NAME
    default "Dima3"

config ZMK_SPLIT_ROLE_CENTRAL
    default y

endif

if SHIELD_DIMA3_LEFT || SHIELD_DIMA3_RIGHT

config ZMK_SPLIT
    default y

endif
```

## app/boards/shields/dima3/Kconfig.shield
```kconfig
config SHIELD_DIMA3_LEFT
    def_bool $(shields_list_contains,dima3_left)

config SHIELD_DIMA3_RIGHT
    def_bool $(shields_list_contains,dima3_right)
```

## config/west.yml
```yaml
manifest:
  remotes:
    - name: zmkfirmware
      url-base: https://github.com/zmkfirmware
    - name: dima3-zmk
      url-base: https://github.com/torshin
  projects:
    - name: zmk
      remote: dima3-zmk
      revision: dima3-module
      import: app/west.yml
  self:
    path: config
```

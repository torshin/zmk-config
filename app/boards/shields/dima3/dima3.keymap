/*
 * Copyright (c) 2020 The ZMK Contributors
 *
 * SPDX-License-Identifier: MIT
 */

#include <behaviors.dtsi>
#include <dt-bindings/zmk/bt.h>
#include <dt-bindings/zmk/keys.h>

#define DEFAULT 0
#define LOWER   1
#define RAISE   2
#define NUM     3
#define THIRD   4

/ {
    keymap {
        compatible = "zmk,keymap";
        default_layer {
          bindings = <
 &kp Q  &kp W
            >;
        };

    };
};
